/*********************************************************
*Copyright (C), 2020-2030, 深圳前海维晟智能技术有限公司
*文件名:	timer2.c
*作  者:	
*版  本:	
*日  期:	
*描  述:	
*备  注:     
**********************************************************/
#include "WS51F6240.h"

/* 注:
 * Timer2: 模式选择
 *		(1).重载模式0: 设置 DCEN = 0，CPRL2 = 0，如果 EXEN2 = 1，则 T2EX 边沿和计数溢出时将触发重载，否则只有计数溢出才能触发重载。
 * 		(2).重载模式1: 设置 DCEN = 1，CPRL2 = 0，此时 T2EX 为低时定时器递减计数，T2EX 为高时定时器递增计数。EXF2 标志不再产生中断，而是作为计数器得第 17 位翻转。    
 * 		(3).抓取模式:  设置 CPRL2 = 1， T2CM = 0，T2EX管脚边沿触发抓取; 设置 CPRL2 = 1， T2CM = 1，软件写入寄存器 T2CL 将触发一次抓取操作
 * 		(4).波特率产生器模式:
 * 		(5).时钟输出模式: 设置 T2OE = 1，此时定时器自动进入计数溢出重载模式T2 引脚输出频率为 2 倍溢出周期的时钟。此模式不能使用 T2 作为时钟输入。
 * Timer2: 管脚配置
 *		(1).计数功能, 使用 T2 输入时钟计数, 管脚T2(P11)设置为输入(P11F = 0x1;), T2MOD.2可选上/下沿计数
 * 		(2).时钟输出模式, 管脚T2(P11)设置为输出(P11F = 0x2;)               
 * 		(3).T2EX抓取或触发重载, 管脚T2EX(P12)设置为输入, T2MOD.3可选上/下沿触发重载或抓取
 */
static void delay_10ms(void)
{
	int j;
	for(j=0;j<17700;++j);
}
static void delay_1ms(void)
{
	int j;
	for(j=0;j<1700;++j);
}
static void delay(int i)
{
	long j;
	for(j=0;j<10*i;++j);
}
/*****************************************************
*函数名称：void Timer2Mode0(void)
*函数功能：重载模式0: 可选 T2EX 边沿触发重载
*入口参数：
*出口参数：
*****************************************************/
void Timer2Mode0(void)
{
	/* 定时器2：重载模式0 */
	//（重载模式A）只有计溢出才能触发重载,计满4.096ms(16bit)
	//（重载模式A1）T2EX 边沿和计溢出时将触发重载,计满4.096ms(16bit)
    T2CH = 0x0;
    T2CL = 0x0;
//    T2CL = (65536-1334);       
//    T2CH = (65536-1334) >> 8;  
    TL2 = T2CL;
    TH2 = T2CH;

    T2MOD = 0+0x80+0x00;//重载模式0,开中断使能,+0x4/T2边沿选择,+0x08/T2EX边沿选择
    T2CON = 0x04 + 0x08;//启动模块,/T2EX使能,+0x02/计数定时选择,+0x1/抓取功能, 
}

/*****************************************************
*函数名称：void Timer2Mode1(void)
*函数功能：重载模式1: EXF2 标志,作为计数器得第 17 位翻转
*入口参数：
*出口参数：
*****************************************************/
void Timer2Mode1(void)
{
	/* 定时器2：重载模式1 */
	//（重载模式B）EXF2第 17 位翻转
    T2CL = 0X00;   
    T2CH = 0X00;
//    T2CH = 0xFF;
//    T2CL = 0xFF;
    TL2 = T2CL;
    TH2 = T2CH;
    
    T2MOD = 1+0x80;//重载模式1,开中断使能,+0x4/T2边沿选择,+0x08/T2EX边沿选择
    T2CON = 0x44;//启动模块,+0x08/T2EX使能,+0x02/计数定时选择,+0x1/抓取功能,
}

/*****************************************************
* 中断服务函数
*****************************************************/
void timer2_isr (void) interrupt 5  
{
/*-------------------------Timer2中断函数------------------------*/
	#if 1//重载模式0
	/* 计数溢出标志为 TF2（T2CON[7]） */
	if(TF2 == 1)
	{		
		TF2 = 0;
		// todo...
		P00 = ~P00;
	}
	
	if(EXF2 == 1) 
    {/* 边沿触发 T2EX */
        EXF2 = 0;
		P01 = ~P01;	
    } 
	#endif

	#if 0//重载模式1
	/* 计数溢出标志为 TF2（T2CON[7]） */
	if(TF2 == 1)
	{ 
		TF2 = 0;
		// todo...	
			P00 = ~P00;	
        if(EXF2 == 0) 
        {
			P01 = ~P01;	
		}
	}
	#endif

}

/**************************************************************
说明：重载模式0：计满溢出触发--P00翻转；边沿触发--P01翻转
			重载模式1；计满溢出触发--P00翻转；EXF2标志不产生中断，作为第17位翻转--P01翻转（时间翻倍）
***************************************************************/
void main()
{  
		int i;
		SCCON = 0x00;//HRC  
	    HRCON |= 0x80;	
    
	
    /**************** 管脚配置 ****************/
		P11F = 0x81;	//输入，外部时钟(TI2),管脚T2(P10)设置为输入，上/下沿计数
		P12F = 0x81;	//上/下沿触发重载 或边沿抓取
	
		P13F = 0x02;
		P14F = 0x02;
	
		/************ Timer2 重载模式 ************/
	  Timer2Mode0();  //重载模式0
//		Timer2Mode1();  //重载模式1
	
    EINT2 = 1;	//开中断 用于 IIC/Timer2/PWM/EP0 中断
    EA = 1;		//总中断	


    while(1)
	{
		P13 = ~P13;
        i= 5;while(i--)delay(100);
	}
}  