/*********************************************************
*Copyright (C), 2020-2030, 深圳前海维晟智能技术有限公司
*文件名:	timer1.c
*作  者:	
*版  本:	
*日  期:	
*描  述:	
*备  注:     
**********************************************************/
#include "WS51F6240.h"	

/* 
* timer0和timer1, 进入中断函数会自动清标志
* Timer0: 模式选择
*			(1).模式0: 定时器 0 作为 13 位定时器/计数器
* 		(2).模式1: 定时器 0 作为 16 位定时器/计数器
* 		(3).模式2: 定时器 0 作为 8 位自动重载定时器/计数器
* 		(4).模式3: TL0 和 TH0 作为两个独立的 8 位定时器/计数器
* Timer1: 模式选择
*			(1).模式0: 定时器 1 作为 13 位定时器/计数器
* 		(2).模式1: 定时器 1 作为 16 位定时器/计数器
* 		(3).模式2: 定时器 1 作为 8 位自动重载定时器/计数器
* 		(4).模式3: 此模式下，TH1、TL1 会被锁住，等效于 TR1=0。
* Timer0/1: 管脚配置
*		(1).计数功能, 管脚T0(P05)设置为输入(P05F = 0x1;)
*		(2).计数功能, 管脚T1(P00)设置为输入(P00F = 0x1;)

		定时时间 = ((最大计数值-初始值)*12*1000*1000) / 晶振频率
		初始值   =  定时时间*晶振频率/分频系数
		晶振频率(16*1000*1000 或 32*1000)
*/


static void delay_1ms(void)
{
	int j;
	for(j=0;j<1700;++j);
}

static void delay_10ms(void)
{
	int j;
	for(j=0;j<17700;++j);
}

/*****************************************************
*函数名称：void init_timer1(void)
*函数功能：Timer1初始化配置
*入口参数：
*出口参数：
*****************************************************/
void init_timer1(void)
{	
	//工作模式0：13 位定时器/计数器，计满6.1440ms(13bit)
    TL1 = (8192-1334) & 0x1F;       //初始值低字节，TL1 的高 3 位是无效的
    TH1 = (8192-1334) >> 5;         //初始值高字节(1ms@16MHz)
    TMOD = 0x00;                	  //定时器,时钟为系统时钟 12 分频 
	
	//工作模式1：16 位定时器，计满49.152ms(16bit)
//    TL1 = (65536-1334);       
//    TH1 = (65536-1334) >> 8;      
//    TMOD = 0x10;  								//模式，+0x40计数定时选择，+0x08门控选择

	//工作模式2：8 位自动重载定时器，计满0.19125ms(8bit)
//    TH1 = 0;       
//    TL1 = 256-134 ; 							//重载值为(256-134); 定时100us	
//    TMOD = 0x20;

	//工作模式3：2个 8 位定时器 TR1=0;
//    TL1 = 0;       
//    TH1 = 0;      
//    TMOD = 0x30;  								//模式，+0x40计数定时选择，+0x08门控选择
								
    ET1 = 1;	//开中断 定时器 1 中断使能控制位
    EA = 1;		//总中断
    TR1 = 1;	//启动定时器
}


/*****************************************************
* 中断服务函数
*****************************************************/
void timer1_isr (void) interrupt 3  
{
    /* set timer1 as mode0 (13-bit) */
    TL1 = (8192-1334) & 0x1F;       //初始值低字节，TL0 的高 3 位是无效的
    TH1 = (8192-1334) >> 5;         //初始值高字节(1ms@16MHz)
	
	/* 工作模式1：16 位定时器 */
//    TL1 = (65536-1334);       
//    TH1 = (65536-1334) >> 8;  
//	
	/* 工作模式2：8 位自动重载定时器,重载寄存器 TH1 */  
//	  TH1 = 0;       
//    TL1 = 256-134; 	//重载值为(256-134); 定时100us
	
	/* 工作模式3：两个 8 位定时器(TL1,TH1) */
//    TL1 = 0; 
	
	    P10 = ~P10;
}


/**************************************************************
说明：例程校准好时钟，工作模式0/1定时约为1ms，工作模式2定时约为100us,
											工作模式3 TR1=0
***************************************************************/
void main()
{    
    SCCON = 0x00;//HRC  
	HRCON |= 0x80;	
	
    /**************** 管脚配置 ****************/
	  P10F = 0x82;	  //推挽输出 Timer1中断
	  P00F = 0x81;	  //计数功能, 管脚T1(P00)
		
	  /************* Timer1初始化配置 *************/
	  init_timer1();

    while(1);
}  
    
