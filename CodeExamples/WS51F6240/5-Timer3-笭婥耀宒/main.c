/*********************************************************
*Copyright (C), 2020-2030, 深圳前海维晟智能技术有限公司
*文件名:	timer3.c
*作  者:	
*版  本:	
*日  期:	
*描  述:	
*备  注:     
**********************************************************/
#include "WS51F6240.h"

/* 注:
 * Timer3: 模式选择
 *		(1).重载模式: 定时器 3 是自动重载向上计数的，在计数溢出或从机功能中选择重载模式由 T3EX 触发时，进行硬件自动重
 *				载，软件可直接改写 T3L 和 T3H 为重载值进行软件重载。
 * 		(2).抓取模式: 设置 EXCE3 和 CPCM3 为 1 选择抓取功能。由 T3XPS 选择 T3EX 上沿或下沿触发抓取操作。软件写入寄存器
 *				T2CL 也可以触发一次抓取操作。
 * 		(3).比较和时钟输出: 设置CPCM3为0选择比较功能。当计数值TL3和TH3的值和寄存器T3CL和T3CH的值相等时，产生中断TCF3。
 *				T3OE 置 1 选择 T3I 输出时钟后：
 *				如果 CPCM3 为 1，则输出波形计数值等于比较值时置 1，在计数溢出时清零；
 *				如果 CPCM3 为 0，则输出波形只在计数溢出时翻转； 
 * 	  (4).门控模式；T3EX 为有效电平时，定时器 3 进行计数，否则计数暂停；
 * Timer3: 管脚配置
 *		(1).计数功能, 使用 T3 输入时钟计数, 管脚T3(P03)设置为输入(P03F = 0x81;), T3MOD可选上/下沿计数               
 * 		(2).T3EX抓取或触发重载, 管脚T3EX(P04)设置为输入, T3MOD可选上/下沿触发重载或抓取
 */
 
static void delay(int i)
{
	long j;
	for(j=0;j<10*i;++j);
}

/*--------------------------- 定时器3 -----------------------------*/
/* T3CON */
#define TF3     0X80		/* 定时器 3 溢出中断  标志 */
#define EXF3    0X40		/* T3EX 触发标志 */
#define CTF3    0X20		/* 抓取/比较中断标志位 */
unsigned char IntFlag=0;
/********************* Timer3中断函数************************/
void timer3_isr (void) interrupt 7
{ 
    if(TF3 == (T3CON&TF3))		//溢出中断标志
    {
        //淸中断
        T3CON &= ~TF3;
        P01 = ~P01;
    }
    
    if(EXF3 == (T3CON&EXF3))	//边沿中断标志
    {
        T3CON &= ~EXF3;
        P00 = ~P00;
    }
	
}

/*****************************************************
*函数名称：void Timer3OverloadMode2(void)
*函数功能：定时器3模式2：边沿触发重载模式
*入口参数：
*出口参数：
*****************************************************/
void Timer3OverloadMode2(void)
{
		/* 定时器3模式2：自动重载模式 */	
		TL3 = 0;
		TH3 = 0;
		T3RL = 0;	//重载值  ---测试  ok
		T3RH = 0;	
						
		T3MOD = 0X50; //边沿中断使能+重载模式
		T3CON = 0X04;	//启动模块
}

/*****************************************************
*函数名称：void Timer3OverloadMode0(void)
*函数功能：定时器3模式0：软件重载模式
*入口参数：
*出口参数：
*****************************************************/
void Timer3OverloadMode0(void)
{
		/* 定时器3模式2：重载模式 */	
		TL3 = 0;
		TH3 = 0;
//		T3RL = 0;	//重载值设置为计满溢出  ---测试  ok
//		T3RH = 0;	
		T3RL = (65536-32768);   //重载值设置为溢出的1/2  --- 测试 ok
		T3RH = (65536-32768)>>8; 
		T3MOD = 0x80;	
		//T3EX重载模式, /开中断使能ok,/T3EX触发中断使能,+0x20/抓取比较中断使能,
		///T3EX边沿选择, +0x02/T3I边沿选择, +0x01/时钟输出使能
		T3CON = 0+0x04;	
		//+0x00,+0x08,+0x10,+0x18/时钟源选择ok, /启动模块, +0x02/抓取功能使能, +0x01/抓取|比较选择
}
/**************************************************************
说明：硬件重载：由T3EX触发重载
			软件重载：直接改写T3L、T3H重载值
***************************************************************/
void main()
{
    SCCON = 0x00;//HRC
		HRCON |= 0X80;

    /**************** 管脚配置 ****************/
		P03F = 0x81; 	  //TI3计数输入口 P03
		P04F = 0x81;		//T3EX触发脚		P04
		
		P00F = 0x02;
		P01F = 0x02;
		P05F = 0x02;
		P10F = 0x02;
	
	
		/********** 定时器3模式2：边沿重载模式 ************/
		Timer3OverloadMode2();
		/********** 定时器3模式0：软件重载模式 ************/
//		Timer3OverloadMode0();

		EINT4 = 1;
    EA = 1;	
	
    while(1)
		{		
			P10 = 1;
			delay(1);
			P10 = 0;
			
			delay(100);
		
		}
}