/*********************************************************
*Copyright (C), 2020-2030, 深圳前海维晟智能技术有限公司
*文件名:	timer2.c
*作  者:	
*版  本:	
*日  期:	
*描  述:	
*备  注:     
**********************************************************/
#include "WS51F6240.h"
#include <stdio.h>

/* 注:
 * Timer2: 模式选择
 *		(1).重载模式0: 设置 DCEN = 0，CPRL2 = 0，如果 EXEN2 = 1，则 T2EX 边沿和计数溢出时将触发重载，否则只有计数溢出才能触发重载。
 * 		(2).重载模式1: 设置 DCEN = 1，CPRL2 = 0，此时 T2EX 为低时定时器递减计数，T2EX 为高时定时器递增计数。EXF2 标志不再产生中断，而是作为计数器得第 17 位翻转。    
 * 		(3).抓取模式:  设置 CPRL2 = 1， T2CM = 0，T2EX管脚边沿触发抓取; 设置 CPRL2 = 1， T2CM = 1，软件写入寄存器 T2CL 将触发一次抓取操作
 * 		(4).波特率产生器模式:
 * 		(5).时钟输出模式: 设置 T2OE = 1，此时定时器自动进入计数溢出重载模式T2 引脚输出频率为 2 倍溢出周期的时钟。此模式不能使用 T2 作为时钟输入。
 * Timer2: 管脚配置
 *		(1).计数功能, 使用 T2 输入时钟计数, 管脚T2(P11)设置为输入(P11F = 0x1;), T2MOD.2可选上/下沿计数
 * 		(2).时钟输出模式, 管脚T2(P11)设置为输出(P11F = 0x2;)               
 * 		(3).T2EX抓取或触发重载, 管脚T2EX(P12)设置为输入, T2MOD.3可选上/下沿触发重载或抓取
 */

static void delay(int i)
{
	long j;
	for(j=0;j<10*i;++j);
}

void UART0_write(signed char dat)
{
    S0BUF = dat;            //Send data to UART buffer
    while(!TI0);
    TI0 = 0;
}

///重定向c库函数printf到串口，重定向后可使用printf函数
char putchar(char ch)
{
    /* 发送一个字节数据到串口 */
    UART0_write((signed char) ch);
        
    return ch;
}
/*****************************************************
*函数名称：void Uart0Mode1(void)
*函数功能：10417 波特率
*入口参数：
*出口参数：
*****************************************************/
void Uart0Mode1(void)
{
    SM00 = 0;
    SM10 = 1;
    REN0 = 0;    //串行接收使能位
    RI0  = 0;     //接收中断标志
    TI0  = 0;     //发送中断标志
	
    /* 默认定时器1作为时钟源(配置位8Bit自动重载模式不开中断程序) */
    /* TL1 作为 8 位定时器/计数器， TH1 作为自动重载寄存器 */
    TR1  = 0;    //先停T1
    TMOD = 0x20;                // 定时器，时钟为系统时钟 12 分频
    TH1  = 256-4;//波特率10417
    TR1  = 1;	//开始运行//timer1 start running  	
}

/*****************************************************
*函数名称：void Timer2SoftCapture(void)
*函数功能：（软件写抓取模式）
*入口参数：
*出口参数：
*****************************************************/
void Timer2SoftCapture(void)
{
	/* 定时器2：（软件写抓取模式） */
    T2CH = 0x0;
    T2CL = 0x0;
    TL2 = T2CL;
    TH2 = T2CH;
    
    T2MOD = 0+0x80+0x10;//重载模式,开中断使能,+0x4/T2边沿选择,+0x08/T2EX边沿选择,/软件抓取
    T2CON = 0x04+0x01;//启动模块,+0x08/T2EX使能,+0x02/计数定时选择,/抓取功能,
}

unsigned char IntFlag=0;
/*****************************************************
* 中断服务函数
*****************************************************/
void timer2_isr (void) interrupt 5  
{
/*-------------------------Timer2中断函数------------------------*/
	if(TF2 == 1)
    {
        TF2 = 0;
    }

	if(EXF2 == 1)
    {
		EXF2 = 0;
		IntFlag = 1;
    }

}
/**************************************************************
说明：软件抓取；直接给T2CL寄存器写值触发抓取
***************************************************************/
void main()
{    
    unsigned int time_val;
    SCCON = 0x00;//HRC  
	HRCON |= 0x80;	
	
	  /****** UART0 模式1（波特率：10417）*******/
    P06F = 6;		//P06--TX
    Uart0Mode1();	
    printf("RUN------\r\n");   
	
    /**************** 管脚配置 ****************/
	  P12F = 0x81;	//边沿触发重载，管脚T2EX(P12)
	  P10F = 0x02;
	
	  /************ Timer2 捕获模式 ************/
	  Timer2SoftCapture();
	  printf("RUN------\r\n"); 

    EINT2 = 1;	/* 用于 IIC/Timer2/PWM/EP0 中断 */
    EA = 1;  
	
    while(1)
    {	
		/* 定时器2,软件写捕获 */
			 TL2 = 0;
			 TH2 = 0;
			 P10 = 1;
			 delay(1);
			 P10 = 0;
	
       T2CL = 0X55;    //软件触发捕获 定时器2  
		
       delay(100);//低电平时间约80us，测试打印值50b ---ok
		
		if(IntFlag == 1)
		{
			IntFlag = 0;
            time_val = (u16)T2CH<<8|T2CL;
			printf("%4x\r\n", time_val);//(int)
		}

    }
}  