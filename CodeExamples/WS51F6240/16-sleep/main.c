/*********************************************************
*Copyright (C), 2020-2030, 深圳前海维晟智能技术有限公司
*文件名:	idle_stop.c
*作  者:	
*版  本:	
*日  期:	
*描  述:	
*备  注:     
**********************************************************/
#include "WS51F6240.h"
#include "intrins.h"

// 寄存器 IDLF 和 STPF 是只读,不能写。

// IDLE 模式
// 1、进入 IDLE 模式前，除了主时钟，其他的时钟源可根据需要选择关闭, 
// 同样进入 IDLE 模式前，可根据需要设定芯片某些外设的开关，打开的外设在 IDLE 下仍然可以正常工作。
// 2、IDLF 事件标志需要处理完成, 才能进入 IDLE 模式
// 3、IDLE 模式下, 所有复位事件和任何中断事件都将唤醒芯片
// 4、需要注意的是，在置位 IDLE（PCON[0]）的指令后面需要紧接4条 nop 指令，防止程序出错。

// STOP 模式
// 1、STOP 模式可以停止所有时钟（包括主时钟）和时钟产生电路。
// 如果 WDT 和 WKT 处于打开状态，则它们使用的时钟模块将处于工作状态。
// 2、STPF 事件标志需要处理完成, 才能进入 STOP 模式
// 3、STOP 模式下, 外部中断、LVD 中断或复位、外部硬复位、WKT 中断、WDT 中断或复位﹑触摸中断来唤醒
// 4、需要注意的是，在置位 STOP 的指令后面需要紧接4条 nop 指令，防止程序出错。

static void delay(int i)
{
	long j;
	for(j=0;j<10*i;++j);
}

static void delay_1ms(void)
{
	int j;
	for(j=0;j<1700;++j);
}

static void delay_10ms(void)
{
	int j;
	for(j=0;j<17700;++j);
}

/*****************************************************
*函数名称：void enterStop(void)
*函数功能：
*入口参数：
*出口参数：
*****************************************************/
void enterStop(void)
{
	if(STPF == 0)
	{			
			P01F=0x00;	
			P00F=0x00;			
		
		//关掉相关外设
		LVDCON = 0x00;
		I2CCON = 0x10;//总线出现STOP信号，中断使能信号
//		ADCON=0x10;
//		ADCFG=0x00;
		HRCON &= 0x7f;
		LRCON &= 0x7f;	
		XSCON = 0x00;		
		TKCON = 0x00;

		SCCON = 0x00;
		MECON |= 0X80;	//IDLE/STOP 模式下，Flash 进入睡眠模式
		
//		PWCON=0xff;     
//		PWCON|=0xE4;     
//		PWCON|=0x80;    
		PWCON|=0x80;     	
		
		
		PCON |= 0X02;	//芯片进入 STOP 模式
		_nop_();
		_nop_();
		_nop_();
		_nop_();
		_nop_();
		//等待唤醒，此处可以读STPF来查看唤醒标志	
	}
}

/*****************************************************
*函数名称：void enterIdle(void)
*函数功能：
*入口参数：
*出口参数：
*****************************************************/
void enterIdle(void)
{
	if(IDLFL == 0)
	{
		//关掉相关外设
		PWCON|=0xff;     
//		PWCON|=0x00;    
//		PWCON|=0x80;     
//		PWCON|=0xc0;     
		
		I2CCON = 0x00;
		HRCON &= 0x7f;
		LRCON &= 0x7f;			
		MECON |= 0X80;	//IDLE/STOP 模式下，Flash 进入睡眠模式
			
		PCON = 0X01;	//芯片进入 IDLE 模式
		_nop_();
		_nop_();
		_nop_();
		_nop_();
		_nop_();
		//等待唤醒，此处可以读IDLF来查看唤醒标志	
	}
}
/******************************************************************
说明：
*******************************************************************/
void main()
{

		int i;
		SCCON = 0x00;
		HRCON |= 0x80;
	
		/***************   管脚配置   **************/
		P10F = 0x02;
		i=30;while(i--)delay(100);	//延时
	
		/*************** 芯片进入 stop **************/
		enterStop();
	
		/*************** 芯片进入 idle **************/
//	enterIdle();
	
	
	while(1);
}