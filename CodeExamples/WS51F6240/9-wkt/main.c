/*********************************************************
*Copyright (C), 2020-2030, 深圳前海维晟智能技术有限公司
*文件名:	wkt.c
*作  者:	
*版  本:	
*日  期:	
*描  述:	
*备  注:     
**********************************************************/

/*********************************WKT简介********************************************
芯片内置了一个自唤醒定时器（WKT），用于低功耗模式下的周期唤醒芯片，也可用作通用定时器。
WKT 可选内部 32K 时钟源 LRC和外部losc时钟，如果开启 WKT 计数，则 LRC 会自动开启。
通过 WKTSS 可选产生一次中断的时间
*************************************************************************************/
#include "WS51F6240.h"	
#include "intrins.h"

static void delay_1ms(void)
{
	int j;
	for(j=0;j<1700;++j);
}

static void delay_10ms(void)
{
	int j;
	for(j=0;j<17700;++j);
}
/*****************************************************
*函数名称：init_wkt(void)
*函数功能：wkt初始化
*入口参数：
*出口参数：
*****************************************************/
void init_wkt(void)
{
	WKTCON = 0X80; /*WKTCON   WKTE  		bit7  使能信号
														WKTCKS   	bit6  wkt时钟选择 
																						0 LRC时钟 
																						1 losc时钟
														WKTIF			bit0  WKT中断标志
									*/
	WKTSS = 0;   // WKTSS bit7-0 中断的时间选择 从0开始值+1对应时间+3.90625ms(losc)/4ms(LRC)
}
/*****************************************************
* 中断服务函数
*****************************************************/
void wkt_isr() interrupt 6 
{
	if((WKTCON&0x01) == 0x01)
	{
		P11 = ~P11;
		WKTCON &= 0xFE;
		// todo...
	}
} 
 
/**************************************************************
说明：例程用LRC时钟 4ms产生中断  改变WKTSS的值可以产生不同的中断时间
			看P11翻转时间 若使用外部时钟losc则把if 0 变为if 1
***************************************************************/
void main()
{    
		SCCON = 0x00;//HRC  
		HRCON |= 0x80;	
#if 0 
/*********************外部losc时钟配置*****************/
	/****************管脚配置	*************/
    P17F = 5;
	P21F = 5;
	
    //使能SCM
    SCMCON = 0x08+0x02; //+0x04
    
    //配置外部时钟使能
    XSCON = 0x08;
    
    //等待外部时钟稳定
    while((XSCON&0x01)==0x0);
		delay_1ms();
	
    //切换系统时钟为外部低速 RC
//	SCCON = 0x40;//LOSC 
#endif
	/*************** 管脚配置 ****************/	
	 P11F=0X02; 

	/*************** 自唤醒定时器 初始化 ****************/	
	 init_wkt();
	
	 IE = 0XC0;   
	 while(1);
}	
