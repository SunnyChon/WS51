/*********************************************************
*Copyright (C), 2020-2030, 深圳前海维晟智能技术有限公司
*文件名:	wdt.c
*作  者:	
*版  本:	
*日  期:	
*描  述:	
*备  注:     
**********************************************************/

/*********************************WDT简介********************************************
看门狗定时器（WDT）为一个 15 位递减计数器，
其计数时钟为 LRC /LOSC 时钟，有 8 位调节精度，计数范围为 7.8125ms-1s。
*************************************************************************************/
#include "WS51F6240.h"	
static void delay_1ms(void)
{
	int j;
	for(j=0;j<1700;++j);
}
/*****************************************************
*函数名称：init_wdt(void)
*函数功能：wdt复位
*入口参数：
*出口参数：
*****************************************************/
void rest_wdt(void)
{
		WDTCON = 0x07;    //产生复位 1s
//	WDTCON = 0x06;    //产生复位 500ms
//	WDTCON = 0x05;    //产生复位 250ms
//	WDTCON = 0x04;    //产生复位 125ms
//	WDTCON = 0x03;    //产生复位 62.5ms
//	WDTCON = 0x02;    //产生复位 31.25ms
//	WDTCON = 0x01;    //产生复位 15.625ms
//	WDTCON = 0x00;    //产生复位 7.8125ms	
    WDTFLG = 0xA5;		//开启	
}

/*****************************************************
*函数名称：init_wdt(void)
*函数功能：wdt中断
*入口参数：
*出口参数：
*****************************************************/
void exint_wdt(void)
{
	  WDTCON = 0x87;    //产生中断 1s     + 0x40  //选择LOSC时钟
//	WDTCON = 0x86;    //产生中断 500ms
//	WDTCON = 0x85;    //产生中断 250ms
//  WDTCON = 0x84;    //产生中断 125ms
//	WDTCON = 0x83;    //产生中断 62.5ms
//	WDTCON = 0x82;    //产生中断 31.25ms
//  WDTCON = 0x81;    //产生中断 15.625ms
//	WDTCON = 0x80;    //产生中断 7.8125ms 
	  WDTFLG = 0xA5;		//开启
}
/*****************************************************
中断函数
*****************************************************/
void Wdt_Isr() interrupt 6
{
	if((WDTFLG&0x02) == 0x02)
	{
		WDTFLG = 0xA5;	//喂狗
		P11 = ~P11;
	}
}

/**************************************************************
说明：WDT复位
	    0030 芯片上电延时约62.7ms，wdt中断可选LRC/LOSC 复位仅可选LRC
***************************************************************/
void main()
{
    SCCON = 0x00;//HRC
	  HRCON |= 0x80;

#if 0
/*********************外部losc时钟配置*****************/
	/****************管脚配置	*************/
    P17F = 5;
	P21F = 5;
	
    //使能SCM
    SCMCON = 0x08+0x02; //+0x04
    
    //配置外部时钟使能
    XSCON = 0x08;
    
    //等待外部时钟稳定
    while((XSCON&0x01)==0x0);
		delay_1ms();
	
    //切换系统时钟为外部低速 RC
//	SCCON = 0x40;//LOSC 
#endif	

	/*************** 管脚配置 ****************/	
	 P11F=0X02; 
	 P10F=0X02;

  /*************** WDT初始化 ****************/	
	 rest_wdt();
//	 exint_wdt();
	
	   IE = 0xC0;		// 使能WDT中断
	
    while(1)
    {	
      P10=~P10;
    }
}