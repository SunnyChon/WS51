/*********************************************************
*Copyright (C), 2020-2030, 深圳前海维晟智能技术有限公司
*文件名:	wdt唤醒.c
*作  者:	
*版  本:	V1.00
*日  期:	
*描  述:	
*备  注:     
**********************************************************/
#include "WS51F6240.h"

#include "intrins.h"
#include <stdio.h>

/*****************************************************
*函数名称：void Uart1Mode1(void)
*函数功能：9600波特率
*入口参数：
*出口参数：
*****************************************************/
void Uart1Mode1(void)
{
	S1CON = 0x80;	///8位异步模式(1), +0x10/中断使能, +0x20/多机通信使能位, +0x40/串行接收使能位
	S1RELL = 972;
	S1RELH = 972>>8;
}

void UART1_write(signed char dat)
{
    S1BUF = dat;            //Send data to UART buffer
    while(TI1 != (S1CON&TI1));
    //清TI1
    S1CON &= ~TI1;
}

///重定向c库函数printf到串口，重定向后可使用printf函数
char putchar(char ch)
{
    /* 发送一个字节数据到串口 */
    UART1_write((signed char) ch);
        
    return ch;
}
/*****************************************************
*函数名称：init_wdt(void)
*函数功能：wdt复位
*入口参数：
*出口参数：
*****************************************************/
void rest_wdt(void)
{
		WDTCON = 0x07;    //产生复位 1s
//	WDTCON = 0x06;    //产生复位 500ms
//	WDTCON = 0x05;    //产生复位 250ms
//	WDTCON = 0x04;    //产生复位 125ms
//	WDTCON = 0x03;    //产生复位 62.5ms
//	WDTCON = 0x02;    //产生复位 31.25ms
//	WDTCON = 0x01;    //产生复位 15.625ms
//	WDTCON = 0x00;    //产生复位 7.8125ms	
    WDTFLG = 0xA5;//开启	
}

/*****************************************************
*函数名称：init_wdt(void)
*函数功能：wdt中断
*入口参数：
*出口参数：
*****************************************************/
void exint_wdt(void)
{
	  WDTCON = 0x87;    //产生中断 1s      + 0x40 //选择LOSC时钟
//	WDTCON = 0x86;    //产生中断 500ms
//	WDTCON = 0x85;    //产生中断 250ms
//  WDTCON = 0x84;    //产生中断 125ms
//	WDTCON = 0x83;    //产生中断 62.5ms
//	WDTCON = 0x82;    //产生中断 31.25ms
//  WDTCON = 0x81;    //产生中断 15.625ms
//	WDTCON = 0x80;    //产生中断 7.8125ms 
	  WDTFLG = 0xA5;//开启
}

/*****************************************************
* 中断服务函数
*****************************************************/
void Wdt_Isr() interrupt 6
{
	if((WDTFLG&0x02) == 0x02)
	{
			P11 = ~P11;
	}
}

/**************************************************************
说明：中断打印结果为 IDLFL=40,IDLFH=0,STPF=10
***************************************************************/
void main()
{
    int i;
    SCCON = 0x00;//HRC
	HRCON |= 0X80;

	  /*************** 管脚配置 ****************/	
	  P02F = 6;			//UART1_RX
	  P16F = 6;			//UART1_TX
	  P10F = 2;		  //推挽输出，翻转IO
	  P11F = 2;     //推挽输出，中断翻转IO
	  P12F = 2;     //推挽
	
	  /************* WDT 初始化 *****************/	
     exint_wdt();
	
     /*************** 串口选择****************/
     Uart1Mode1();	//P17F=8;//UART1_TX
     printf("RUN------\r\n");
	
    while(1)
    {	
		/*********************** WDT唤醒测试 ***********************/

		if((IDLFL == 0) && (IDLFH == 0))
//		if(STPF == 0)
        {
            P12=~P12;
			_nop_();
			_nop_();
            P12=~P12;
					 printf("SLEEP------\r\n");

			HRCON &= 0x7f;
			LRCON &= 0x7f;			
			MECON |= 0X80;	//IDLE/STOP 模式下，Flash 进入睡眠模式
			
			/*************** 芯片进入休眠 **************/
			PCON |= 1;//idle
//            PCON |= 0X02;    //芯片进入 STOP 模式
			_nop_();
			_nop_();
			_nop_();
			//等待唤醒
			printf("IDLFL=%bx,IDLFH=%bx,STPF=%bx\r\n",IDLFL,IDLFH,STPF);
				WDTFLG = 0xA5;	//喂狗
        }
		
    }
}

    
 
    
   
    




