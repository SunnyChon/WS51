/*********************************************************
*Copyright (C), 2020-2030, 深圳前海维晟智能技术有限公司
*文件名:	uart0唤醒.c
*作  者:	
*版  本:	
*日  期:	
*描  述:	
*备  注:     
**********************************************************/
#include "WS51F6240.h"
#include "intrins.h"
#include <stdio.h>

static void delay_1ms(void)
{
	int j;
	for(j=0;j<1700;++j);
}

void UART0_write(signed char dat)
{
    S0BUF = dat;            //Send data to UART buffer
    while(!TI0);
    TI0 = 0;
}

///重定向c库函数printf到串口，重定向后可使用printf函数
char putchar(char ch)
{
    /* 发送一个字节数据到串口 */
    UART0_write((signed char) ch);
        
    return ch;
}

/*****************************************************
* 中断服务函数
*****************************************************/
void Uart0_Isr() interrupt 4
{
    if(RI0 == 1)     //如果接收到计算机发的数据
    {
        RI0 = 0;     //清除标志位
        P11 = P11;
    }
}	

/*****************************************************
*函数名称：void Uart0Mode1(void)
*函数功能：9600波特率
*入口参数：
*出口参数：
*****************************************************/
void Uart0Mode1(void)
{
    /*************** UART0 模式1（波特率：9600）****************/
    SM00 = 0;
    SM10 = 1;
    REN0 = 1;    //串行接收使能位
    RI0 = 0;     //接收中断标志
    TI0 = 0;     //发送中断标志
    
	//TIMER2 作为uart0的波特率时钟源
    TR2 = 0;
    T2MOD = 0x00;/* 定时2中断不使能，不分频 */
    T2CL = 65536 - 52;			//48对应的是10417
    T2CH = 65536 - 52 >> 8; //52对应的是9600
    TL2 = T2CL;
    TH2 = T2CH;
    TR2 = 1;    //启动定时器2
    RCLK = 1;
    TCLK = 1;	
}
/**************************************************************************
说明：UART0 模式1，芯片进入idle模式，可通过RX唤醒
			打印结果为 IDLFL=10,IDLFH=0,STPF=0
**************************************************************************/
void main()
{
    int i;
    SCCON = 0x00;//HRC
		HRCON |= 0X80;
	
    /***********************管脚配置*********************/
	  P10F = 0x02;		//推挽输出，翻转IO
	  P11F = 0x02;     //推挽输出，中断翻转IO
	  P12F = 0x02;     //推挽输出，进入休眠IO翻转
	  P07F = 6;	//RX
	  P06F = 6;	//TX
    
	  /***********************串口的选择*********************/
    Uart0Mode1();	
    printf("RUN------\r\n");
	  ES0 = 1;	/* UART0 中断控制位 */
	 

 while(1)
   {	
		RI0 = 0;	//清除标志位
		if((IDLFL == 0) && (IDLFH == 0))
//		if(STPF == 0)
        {
            P12=~P12;
			_nop_();
			_nop_();
            P12=~P12;
			printf("sleep\r\n");
			
			HRCON &= 0x7f;
			LRCON &= 0x7f;
			MECON |= 0X80;	//IDLE/STOP 模式下，Flash 进入睡眠模式
			
			/*************** 芯片进入休眠 **************/
			PCON |= 1;		//芯片进入 idle 模式
//            PCON |= 0X02;    //芯片进入 STOP 模式
			_nop_();
			_nop_();
			_nop_();
			_nop_();
			//等待唤醒
			printf("IDLFL=%bx,IDLFH=%bx,STPF=%bx\r\n",IDLFL,IDLFH,STPF);
			
        }
		
    }
}

    
 
    
   
    




