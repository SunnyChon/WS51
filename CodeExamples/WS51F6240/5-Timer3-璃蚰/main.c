/*********************************************************
*Copyright (C), 2020-2030, 深圳前海维晟智能技术有限公司
*文件名:	timer3.c
*作  者:	
*版  本:	
*日  期:	
*描  述:	
*备  注:     
**********************************************************/
#include "WS51F6240.h"
#include <stdio.h>

/* 注:
 * Timer3: 模式选择
 *		(1).重载模式: 定时器 3 是自动重载向上计数的，在计数溢出或从机功能中选择重载模式由 T3EX 触发时，进行硬件自动重
 *				载，软件可直接改写 T3L 和 T3H 为重载值进行软件重载。
 * 		(2).抓取模式: 设置 EXCE3 和 CPCM3 为 1 选择抓取功能。由 T3XPS 选择 T3EX 上沿或下沿触发抓取操作。软件写入寄存器
 *				T2CL 也可以触发一次抓取操作。
 * 		(3).比较和时钟输出: 设置CPCM3为0选择比较功能。当计数值TL3和TH3的值和寄存器T3CL和T3CH的值相等时，产生中断TCF3。
 *				T3OE 置 1 选择 T3I 输出时钟后：
 *				如果 CPCM3 为 1，则输出波形计数值等于比较值时置 1，在计数溢出时清零；
 *				如果 CPCM3 为 0，则输出波形只在计数溢出时翻转； 
 * 	  (4).门控模式；T3EX 为有效电平时，定时器 3 进行计数，否则计数暂停；
 * Timer3: 管脚配置
 *		(1).计数功能, 使用 T3 输入时钟计数, 管脚T3(P03)设置为输入(P03F = 0x81;), T3MOD可选上/下沿计数               
 * 		(2).T3EX抓取或触发重载, 管脚T3EX(P04)设置为输入, T3MOD可选上/下沿触发重载或抓取
 */
 
static void delay(int i)
{
	long j;
	for(j=0;j<10*i;++j);
}

//=========================================================
/* S1CON串口1控制寄存器 */
#define SM11    0x80            /* 工作模式选择 */
#define IE1     0x40            /* 中断使能， 1 有效 */
#define SM21    0x20            /* 多机通信使能位， 1 有效 */
#define REN1    0x10            /* 串行接收使能位， 1 有效 */
#define TB81    0x08            /* 发送的第 9 位数据 */
#define RB81    0x04            /* 接收的第 9 位数据 */
#define TI1     0x02            /* 发送中断标志， 1 有效，写 0 清除 */
#define RI1     0x01            /* 接收中断标志， 1 有效，写 0 清除 */

void UART1_write(signed char dat)
{
    S1BUF = dat;            //Send data to UART buffer
    while(TI1 != (S1CON&TI1));
    //清TI1
    S1CON &= ~TI1;
}

///重定向c库函数printf到串口，重定向后可使用printf函数
char putchar(char ch)
{
    /* 发送一个字节数据到串口 */
    UART1_write((signed char) ch);
        
    return ch;
}
/*****************************************************
*函数名称：void Uart1Mode1(void)
*函数功能：9600 波特率
*入口参数：
*出口参数：
*****************************************************/
void Uart1Mode1(void)
{
    /*************** UART1 模式1（波特率：9600）****************/
		S1CON = 0x80;	///8位异步模式(1), +0x10/中断使能, +0x20/多机通信使能位, +0x40/串行接收使能位
		S1RELL = 972;
		S1RELH = 972>>8;	
}



/*--------------------------- 定时器3 -----------------------------*/
/* T3CON */
#define TF3     0X80		/* 定时器 3 溢出中断  标志 */
#define EXF3    0X40		/* T3EX 触发标志 */
#define CTF3    0X20		/* 抓取/比较中断标志位 */


#define IOF_TI3 	P12F
#define IOF_T3EX 	P13F
#define IO_TI3 		P12
#define IO_T3EX 	P13

unsigned char IntFlag=0;
 /********************* Timer3中断函数************************/
void timer3_isr (void) interrupt 7
{ 
    if(TF3 == (T3CON&TF3))	//溢出中断标志
    {
        //淸中断
        T3CON &= ~TF3;
        P00 = ~P00;
    }
    
    if(EXF3 == (T3CON&EXF3))	//边沿中断标志
    {
        T3CON &= ~EXF3;
        P01 = ~P01;
    }
    
    
    if(CTF3 == (T3CON&CTF3))	//抓取中断标志
    {
        T3CON &= ~CTF3;
        P02 = ~P02;
				IntFlag = 1;
    }
}

/*****************************************************
*函数名称：void Timer2SoftCapture(void)
*函数功能：（软件写抓取模式）
*入口参数：
*出口参数：
*****************************************************/
void Timer3SoftCapture(void)
{
	/* 定时器2：（软件写抓取模式） */
    T3CH = 0x0;
    T3CL = 0x0;
    TL3 = T3CL;
    TH3 = T3CH;
    
    T3MOD = 0xA0;//重载模式,开中断使能,+0x4/T2边沿选择,+0x08/T2EX边沿选择,/软件抓取
    T3CON = 0x05;//启动模块,+0x08/T2EX使能,+0x02/计数定时选择,/抓取功能,
}

/**************************************************************
说明：
***************************************************************/
void main()
{    
    unsigned int time_val;
    SCCON = 0x00;//HRC  
		HRCON |= 0x80;	
	
	  /****** UART1 模式1（波特率：9600）*******/
    Uart1Mode1();	
    printf("RUN------\r\n");   
	
    /**************** 管脚配置 ****************/
		P04F = 0x81;	//边沿触发重载，管脚T3EX(P04)
		P16F = 6;		//P16--TX
		
		P10F = 0x02;
		P00F = 0X02;
		P02F = 0X02;
		P01F = 0X02;
	
		/************ Timer2 捕获模式 ************/
		Timer3SoftCapture();

    EINT4 = 1;	/* 用于 Timer3中断 */
    EA = 1;  
	
    while(1)
    {	
		 /* 定时器3,软件写捕获 */
        TL3 = 0;
        TH3 = 0;	
		    P10 = 1;
        delay(1);
			  P10 = 0;
		
        T3CL = 0Xaa;    //软件触发捕获 定时器2  

        delay(100);			//低电平时间约80us，测试打印值约为50b ---ok
		
		if(IntFlag == 1)
		{
			IntFlag = 0;
            time_val = (u16)T3CH<<8|T3CL;
			printf("%4x\r\n", time_val);//(int)
		}

    }
}  
