/*********************************************************
*Copyright (C), 2020-2030, 深圳前海维晟智能技术有限公司
*文件名:	uart0.c
*作  者:	
*版  本:	
*日  期:	
*描  述:	
*备  注:     
**********************************************************/
#include "WS51F6240.h"
#include <stdio.h>
static void delay(int i)
{
	long j;
	for(j=0;j<10*i;++j);
}
static void delay_1ms(void)
{
	int j;
	for(j=0;j<1700;++j);
}

void UART0_write(signed char dat)
{
    S0BUF = dat;            //Send data to UART buffer
    while(!TI0);
    TI0 = 0;
}

///重定向c库函数printf到串口，重定向后可使用printf函数
char putchar(char ch)
{
    /* 发送一个字节数据到串口 */
    UART0_write((signed char) ch);
        
    return ch;
}


unsigned char dat0;
unsigned char Rx_flag=0;

/*****************************************************
* 中断服务函数
*****************************************************/
void Uart_Isr() interrupt 4
{
    if(RI0 == 1)     //如果接收到计算机发的数据
    {
        RI0 = 0;     //清除标志位
        dat0 = S0BUF;  
        Rx_flag = 1;
    }
		
}


/*****************************************************
*函数名称：void Uart0Mode1(void)
*函数功能：8 位异步模式，波特率：可调(T1/T2)
*入口参数：
*出口参数：
*****************************************************/
void Uart0Mode1(void)
{
    SM00 = 0;
    SM10 = 1;	//模式选择: 模式1
    REN0 = 1; 	//串行接收使能位
    RI0 = 0;  	//接收中断标志
    TI0 = 0;  	//发送中断标志
//	
//    /* 默认定时器1作为时钟源(配置位8Bit自动重载模式不开中断程序) */
//    /* TL1 作为 8 位定时器/计数器， TH1 作为自动重载寄存器 */
//    TR1 = 0;    //先停T1
//    TMOD = 0x20;                // 定时器，时钟为系统时钟 12 分频
//    TH1 = 256-4;//波特率10417
//    TR1 = 1;	//开始运行//timer1 start running  	
    
	//TIMER2 作为uart0的波特率时钟源 配置波特率为9600
    TR2 = 0;
    T2MOD = 0x00;/* 定时2中断不使能，不分频 */
    T2CL = 65536 - 52;
    T2CH = 65536 - 52 >> 8;//波特率：9600
    TL2 = T2CL;
    TH2 = T2CH;
    TR2 = 1;    //启动定时器2
    RCLK = 1;   //UART0在模式1和3时使用定时器1/2作为接收波特率时钟
    TCLK = 1;		//UART0在模式1和3时使用定时器1/2作为接收波特率时钟
}
/*****************************************************
*函数名称：void Uart0Mode1(void)
*函数功能：9 位异步模式，波特率：Fsys/64或Fsys/32
*入口参数：
*出口参数：
*****************************************************/
void Uart0Mode2(void)
{
    SM00 = 1;
    SM10 = 0;	//模式选择: 模式2
    REN0 = 1; 	//串行接收使能位
    RI0 = 0;  	//接收中断标志
    TI0 = 0;  	//发送中断标志
	

}
/*****************************************************
*函数名称：void Uart0Mode1(void)
*函数功能：9 位异步模式，波特率：可调(T1/T2)
*入口参数：
*出口参数：
*****************************************************/
void Uart0Mode3(void)
{
    SM00 = 1;
    SM10 = 1;	//模式选择: 模式3
    REN0 = 1; 	//串行接收使能位
    RI0 = 0;  	//接收中断标志
    TI0 = 0;  	//发送中断标志
		TB80 = 0;
		RB80 = 0;	
	
    /* 默认定时器1作为时钟源(配置位8Bit自动重载模式不开中断程序) */
    /* TL1 作为 8 位定时器/计数器， TH1 作为自动重载寄存器 */
//    TR1 = 0;    //先停T1
//    TMOD = 0x20;                // 定时器，时钟为系统时钟 12 分频
//    TH1 = 256-4;//波特率10417
//    TR1 = 1;	//开始运行//timer1 start running  	
    
	//TIMER2 作为uart0的波特率时钟源
    TR2 = 0;
    T2MOD = 0x00;/* 定时2中断不使能，不分频 */
    T2CL = 65536 - 52;
    T2CH = 65536 - 52 >> 8;//波特率：9600
    TL2 = T2CL;
    TH2 = T2CH;
    TR2 = 1;    //启动定时器2
    RCLK = 1;	
    TCLK = 1;	
}
/**************************************************************************
说明：RX接P06 TX接P07  串口调试助手进行数据的收发,波特率的选择看附件文档
**************************************************************************/
void main()
{
    SCCON = 0x00;//HRC
	HRCON |= 0X80;
    delay_1ms();
	
    /*************************管脚配置**********************/ 
    P07F = 6;//RX
    P06F = 6;//TX

	P15F = 0x81;

    /****** UART0 模式1（波特率：9600 可调）**************/
    Uart0Mode1();
    /****** UART0 模式2（波特率：Fsys/64或Fsys/32）*******/
//	PCON |= 0x80;	//倍频
//    Uart0Mode2();
    /****** UART0 模式3（波特率：9600 可调）**************/
//    Uart0Mode3();	
	
	
	/* 倍频选择配置,用于Uart0模式1,2,3 */
//	PCON |= 0x80;
	
	
    ES0 = 1;	/* UART0 中断开 */
    EA = 1;
	
	
    printf("RUN------\r\n");
    while(1)
    {
        if(Rx_flag == 1)
        {
            Rx_flag = 0;
            UART0_write(dat0);
        }
        
        if(P15 == 0)//接收处理
        {
            delay(10);
            if(P15 == 0)
            {
                while(P15 == 0);
                printf("U"); //对应的十六进制为0x55
            }
        }
           
    }


}