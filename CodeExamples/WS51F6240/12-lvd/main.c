/*********************************************************
*Copyright (C), 2020-2030, 深圳前海维晟智能技术有限公司
*文件名:	LVD.c
*作  者:	
*版  本:	
*日  期:	
*描  述:	
*备  注:     
**********************************************************/

/*********************************lvd简介********************************************
LVD用于监控芯片自身的供电电压VDD，可检测电压范围为 1.8V-4.2V，精度±50mV。
配置寄存器 LVDS 不为 0 时开启 LVD 功能，其触发电压阈值由寄存器 LVDTH 设置。
当芯片 VDD 出现由高变低到 LVDTH 设置的阈值时，LVDF 位将置 1。此时，如果 LVDS 为 1 则产生 LVD 中断，
如果 LVDS 为 2 则产生 LVD 复位，如果 LVDS 为 3 则芯片即不复位也不产生中断，此时通过 LVDF 标志可初步判断
芯片电源电压。如果产生了 LVD 复位，不会复位寄存器 LVDCON。
*************************************************************************************/

#include "WS51F6240.h"	
#include <stdio.h>
unsigned int j=0;
static void delay(int i)
{
	long j;
	for(j=0;j<10*i;++j);
}
static void delay_1ms(void)
{
	int j;
	for(j=0;j<1700;++j);
}
static void delay_10ms(void)
{
	int j;
	for(j=0;j<17700;++j);
}

/*****************************************************
*函数名称：void init_lvd(void)
*函数功能：
*入口参数：
*出口参数：
*****************************************************/
void init_lvd(void)
{
	LVDCON = 0x40; 		//低压时产生中断, 低压阈值设置1.8V
	
//  LVRCON = 0x80; 		//低压时产生复位, 低压阈值设置1.8V
	
//	LVRCON = 0xC0; 		//低压时产生中断不产生中断和复位, 低压阈值设置1.8V
}

/*****************************************************
* 中断服务函数
*****************************************************/
void lvd_isr() interrupt 6 
{
	if((LVDCON&0x01) == 0x01)
	{
		LVDCON  &= 0xFE;
		// todo...
		P10 = ~P10;
	}
}


void main()
{
   //系统时钟配置
		SCCON = 0x00;//选择HRC时钟
		HRCON |= 0x80; //HRC使能
	
	  /****************** 管脚配置 ********************/
		P10F = 2; 
		P11F = 2; 

    /*************** LVD 初始化配置 *****************/
		init_lvd();
		IE = 0xC0;			//使能LVD中断开	
	
while(1)
    {			
      P11 =~P11;
    }

}